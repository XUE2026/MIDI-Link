## esp32-midi-gateway/sdkconfig.defaults
```kconfig
CONFIG_ESPTOOLPY_CHIP="ESP32S3"
CONFIG_ESPTOOLPY_FLASHMODE_QIO=y
CONFIG_ESPTOOLPY_FLASHFREQ_80M=y
CONFIG_ESPTOOLPY_FLASHSIZE_16MB=y
CONFIG_ESP32S3_SPIRAM_SUPPORT=y
CONFIG_ESP32S3_SPIRAM_MODE_OCT=y
CONFIG_ESP32S3_SPIRAM_SIZE_8MB=y
CONFIG_PARTITION_TABLE_OFFSET=0x8000
CONFIG_PARTITION_TABLE_TWO_OTA=y
CONFIG_ESP_SYSTEM_PANIC_PRINT_HALT=y
CONFIG_FREERTOS_HZ=1000
CONFIG_LWIP_LOCAL_HOSTNAME="esp32-midi-gateway"
CONFIG_ESP_WIFI_SOFTAP_SUPPORT=y
CONFIG_ESP_TLS_USING_MBEDTLS=y
CONFIG_HTTPD_MAX_REQ_HDR_LEN=1024
CONFIG_HTTPD_MAX_URI_LEN=1024
CONFIG_ESPTOOLPY_MONITOR_BAUD=115200
CONFIG_CONSOLE_UART_BAUDRATE=115200
CONFIG_ESPTOOLPY_BAUD_OTHER_VAL=921600
```
